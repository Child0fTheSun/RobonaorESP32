## sdkconfig.defaults
```kconfig
# BLE / NimBLE (только BLE, без Classic BT)
CONFIG_BT_ENABLED=y
CONFIG_BT_CONTROLLER_ENABLED=y
CONFIG_BT_NIMBLE_ENABLED=y
CONFIG_BT_NIMBLE_ROLE_PERIPHERAL=y
CONFIG_BT_NIMBLE_ROLE_BROADCASTER=y
# Classic BT отключён
CONFIG_BT_CLASSIC_ENABLED=n
```
